/dts-v1/;

/ {
	compatible = "brcm,bcm2835";

	fragment@0 {
		target = < 0xffffffff >;

		__overlay__ {
			pinctrl-names = "default";
			pinctrl-0 = < 0x01 >;
			status = "okay";
		};
	};

	fragment@1 {
		target = < 0xffffffff >;

		__overlay__ {

			smi_pins {
				brcm,pins = < 0x02 0x03 0x04 0x05 0x06 0x07 0x08 0x09 0x0a 0x0b 0x0c 0x0d 0x0e 0x0f 0x10 0x11 0x12 0x13 0x14 0x15 0x16 0x17 0x18 0x19 >;
				brcm,function = < 0x05 0x05 0x05 0x05 0x05 0x05 0x05 0x05 0x05 0x05 0x05 0x05 0x05 0x05 0x05 0x05 0x05 0x05 0x05 0x05 0x05 0x05 0x05 0x05 >;
				brcm,pull = < 0x02 0x02 0x02 0x02 0x02 0x02 0x00 0x00 0x00 0x00 0x00 0x00 0x00 0x00 0x00 0x00 0x00 0x00 0x00 0x00 0x00 0x00 0x00 0x00 >;
				phandle = < 0x01 >;
			};
		};
	};

	__symbols__ {
		smi_pins = "/fragment@1/__overlay__/smi_pins";
	};

	__fixups__ {
		smi = "/fragment@0:target:0";
		gpio = "/fragment@1:target:0";
	};

	__local_fixups__ {

		fragment@0 {

			__overlay__ {
				pinctrl-0 = < 0x00 >;
			};
		};
	};
};
