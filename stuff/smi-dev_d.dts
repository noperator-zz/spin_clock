/dts-v1/;

/ {

	fragment@0 {
		target = < 0xffffffff >;

		__overlay__ {

			smi_dev {
				compatible = "brcm,bcm2835-smi-dev";
				smi_handle = < 0xffffffff >;
				status = "okay";
			};
		};
	};

	__fixups__ {
		soc = "/fragment@0:target:0";
		smi = "/fragment@0/__overlay__/smi_dev:smi_handle:0";
	};
};
